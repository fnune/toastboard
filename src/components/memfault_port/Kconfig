## src/components/memfault_port/Kconfig
```kconfig
config MEMFAULT_API_KEY
    string "Your Memfault project API key"
    default "YOUR_PROJECT_API_KEY"
    help
        Get it from https://app.memfault.com/organizations/memfault/projects/toastboard/settings
```

## src/main/Kconfig
```kconfig
config WIFI_SSID
    string "Your WiFi SSID"
    default "WIFI_SSID"

config WIFI_PASSWORD
    string "Your WiFi password"
    default "WIFI_PASSWORD"
```

## src/sdkconfig.defaults
```kconfig
CONFIG_LWIP_NETIF_LOOPBACK=y
CONFIG_LWIP_LOOPBACK_MAX_PBUFS=1
CONFIG_PARTITION_TABLE_TWO_OTA=y
```
